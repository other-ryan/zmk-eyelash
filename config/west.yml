## config/west.yml
```yaml
manifest:
  remotes:
    - name: zmkfirmware
      url-base: https://github.com/zmkfirmware
    - name: gpeye
      url-base: https://github.com/GPeye
    - name: cormoran
      url-base: https://github.com/cormoran
  projects:
    - name: eyelash_corne
      url: https://github.com/a741725193/zmk-new_corne
      revision: main
    - name: zmk
      remote: zmkfirmware
      revision: main
      import: app/west.yml
    - name: mario-peripheral-animation
      remote: gpeye
      revision: main 
    - name: zmk-module-battery-history
      remote: cormoran
      revision: main
  self:
    path: config
```
